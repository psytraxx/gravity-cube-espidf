## main/Kconfig.projbuild
```kconfig
menu "Gravity cube"

config CUBE_LED_GPIO
    int "LED data GPIO"
    default 2
    help
        Data line of the WS2812 chain, through a 330 ohm series
        resistor. GPIO 2 is on the ESP32-S3 SuperMini's header and is
        not a strapping pin on the ESP32-S3.

choice CUBE_PANEL_WIRING
    prompt "Panel wiring"
    default CUBE_PANEL_WIRING_ROWS
    help
        How the chain runs through each panel, starting from IN at the
        bottom of the edge a side panel shares with the previous one.

config CUBE_PANEL_WIRING_ROWS
    bool "Rows"
    help
        Along the bottom row, then each row above it from the same side,
        to OUT at the top of the edge with the next panel.

config CUBE_PANEL_WIRING_ZIGZAG
    bool "Zigzag columns"
    help
        Up the first column, down the next and so on, to OUT at the
        bottom of the edge with the next panel.

endchoice

config CUBE_FRAME_MS
    int "Physics step period (ms)"
    default 18
    range 5 100
    help
        One physics step per period. The physics constants are per step,
        so a longer period slows the fluid down. A fluid step takes about
        17 ms on the ESP32-S3, so 18 ms (55 steps a second) is the
        shortest period it keeps up with; the LED chain needs ~11.5 ms.

config CUBE_ASSEMBLY_PATTERN
    bool "Assembly pattern instead of the fluid"
    default n
    help
        For putting the panels into the case: show a still pattern
        instead of the fluid. Each panel shows its own
        colour in its centre (Left red, Back green, Right blue, Front
        yellow, Bottom magenta, Top white) and, along each edge, the
        colour of the panel across that edge; corners stay dark. Every
        edge strip should match the centre of the panel beside it. A
        wrong centre colour means a panel in the wrong place, edge
        colours on the wrong sides a panel turned or flipped.

config CUBE_TAP_THRESHOLD_MG
    int "Tap threshold (mg)"
    default 1000
    range 125 3875
    help
        Jump in acceleration that the BMI160's tap engine counts as a tap,
        in steps of 125 mg. Raise it if sloshing the fluid changes its
        colour, lower it if double taps are missed.

config CUBE_IMU_SPI_MOSI
    int "SPI MOSI GPIO (board SDA)"
    default 11

config CUBE_IMU_SPI_MISO
    int "SPI MISO GPIO (board SA0)"
    default 13

config CUBE_IMU_SPI_SCLK
    int "SPI SCLK GPIO (board SCL)"
    default 12

config CUBE_IMU_SPI_CS
    int "SPI CS GPIO (board CS)"
    default 10

config CUBE_IMU_INT1
    int "IMU INT1 GPIO (board INT1)"
    default 9
    help
        The BMI160 drives INT1 high on a double tap and holds it there
        until the firmware has read it. GPIO 9 is on the SuperMini's
        header and is not a strapping pin.

config CUBE_IMU_I2C_SCAN
    bool "Scan for I2C devices on the IMU pins at startup"
    default n
    help
        Wiring check: before setting up SPI, hold CS high (which keeps the
        BMI160 on I2C) and probe every address with SCL on the SCLK pin
        and SDA on the MOSI pin. A BMI160 answers at 0x68 (SA0 low) or
        0x69 (SA0 high). The SPI setup switches the chip to SPI until it
        is power cycled, so the scan only finds it after a power on, not
        after a reset.

menu "Wi-Fi and firmware updates"

config CUBE_WIFI_SSID
    string "Wi-Fi SSID"
    default ""
    help
        Network to join for firmware updates over Wi-Fi. Empty turns Wi-Fi
        off, and with it updates over Wi-Fi.

config CUBE_WIFI_PASSWORD
    string "Wi-Fi password"
    default ""
    help
        Empty for an open network.

config CUBE_HOSTNAME
    string "Hostname"
    default "cube"
    help
        DHCP and mDNS name: the cube answers at http://<hostname>.local/.

config CUBE_OTA_TOKEN
    string "Update token"
    default ""
    help
        If set, an update must carry the header
        "Authorization: Bearer <token>". Empty lets anyone on the network
        update the cube.

endmenu

endmenu
```
